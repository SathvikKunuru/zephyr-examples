## CMakeLists.txt
```
# SPDX-License-Identifier: Apache-2.0

cmake_minimum_required(VERSION 3.20.0)

find_package(Zephyr REQUIRED HINTS $ENV{ZEPHYR_BASE})
project(base_project)

target_sources(app PRIVATE src/main.c)
```

## prj.conf
```kconfig
#nothing here

# Serial driver (required for CDC-ACM)
CONFIG_SERIAL=y

# USB Device Stack
CONFIG_USB_DEVICE_STACK=y
CONFIG_USB_DEVICE_INITIALIZE_AT_BOOT=y

# CDC-ACM (Virtual COM Port)
CONFIG_USB_CDC_ACM=y
CONFIG_USB_CDC_ACM_RINGBUF_SIZE=256

# Console
CONFIG_CONSOLE=y

# USB Device IDs
CONFIG_USB_DEVICE_VID=0x2FE3
CONFIG_USB_DEVICE_PID=0x0100
CONFIG_USB_DEVICE_PRODUCT="Zephyr USB"
CONFIG_USB_DEVICE_MANUFACTURER="STM32"
CONFIG_USB_MAX_POWER=100

# Enable console output over USB CDC-ACM
CONFIG_UART_CONSOLE=y
CONFIG_LOG_BACKEND_UART=n
CONFIG_PRINTK=y
```

## src/main.c
```c
/*
 * Copyright (c) 2012-2014 Wind River Systems, Inc.
 *
 * SPDX-License-Identifier: Apache-2.0
 */

#include <stdio.h>
#include <string.h>
#include <zephyr/kernel.h>

int main(void)
{
	/* Use both printk and printf for testing */
	printk("=== Starting Tracker ===\n");
	
	/* Wait for USB enumeration and console to be ready */
	k_sleep(K_MSEC(3000));


	return 0;
}
```
