## hello_world/build/Kconfig/arch/Kconfig
```kconfig
# Load Zephyr Arch Kconfig descriptions.
osource "/home/sathvik/zephyrproject/zephyr/arch/rx/Kconfig"
osource "/home/sathvik/zephyrproject/zephyr/arch/x86/Kconfig"
osource "/home/sathvik/zephyrproject/zephyr/arch/xtensa/Kconfig"
osource "/home/sathvik/zephyrproject/zephyr/arch/sparc/Kconfig"
osource "/home/sathvik/zephyrproject/zephyr/arch/riscv/Kconfig"
osource "/home/sathvik/zephyrproject/zephyr/arch/posix/Kconfig"
osource "/home/sathvik/zephyrproject/zephyr/arch/mips/Kconfig"
osource "/home/sathvik/zephyrproject/zephyr/arch/arm64/Kconfig"
osource "/home/sathvik/zephyrproject/zephyr/arch/arm/Kconfig"
osource "/home/sathvik/zephyrproject/zephyr/arch/arc/Kconfig"
```

## hello_world/build/Kconfig/boards/Kconfig
```kconfig
# Load Zephyr board Kconfig descriptions.
osource "/home/sathvik/zephyrproject/zephyr/boards/st/custom_u575vit6q/Kconfig"
```

## hello_world/build/Kconfig/boards/Kconfig.defconfig
```kconfig
# Load Zephyr board defconfig descriptions.
osource "/home/sathvik/zephyrproject/zephyr/boards/st/custom_u575vit6q/Kconfig.defconfig"
```
